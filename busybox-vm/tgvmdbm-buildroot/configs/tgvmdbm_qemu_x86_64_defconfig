## busybox-vm/tgvmdbm-buildroot/configs/tgvmdbm_qemu_x86_64_defconfig
```kconfig
BR2_x86_64=y
BR2_x86_corei7_avx=y
BR2_TARGET_GENERIC_HOSTNAME="tgvmdbm"
BR2_TARGET_GENERIC_ISSUE="Welcome to TGVMDBM"
BR2_SYSTEM_DHCP="eth0"
BR2_ROOTFS_OVERLAY="$(BR2_EXTERNAL_TGVMDBM_PATH)/board/tgvmdbm/qemu_x86_64/rootfs_overlay"
BR2_LINUX_KERNEL=y
BR2_LINUX_KERNEL_USE_CUSTOM_CONFIG=y
BR2_LINUX_KERNEL_CUSTOM_CONFIG_FILE="$(BR2_EXTERNAL_TGVMDBM_PATH)/board/tgvmdbm/qemu_x86_64/linux.config"
BR2_PACKAGE_FIO=y
BR2_PACKAGE_PCIUTILS=y
BR2_PACKAGE_OPENSSH=y
BR2_PACKAGE_SOCAT=y
BR2_TARGET_ROOTFS_CPIO=y
```
